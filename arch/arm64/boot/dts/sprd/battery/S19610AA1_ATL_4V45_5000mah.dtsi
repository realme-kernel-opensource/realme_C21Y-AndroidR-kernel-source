/*ATL 68K*/
/ {
    fragment {
            target-path = "/";
            __overlay__ {

            bat1: battery1 {
                compatible = "simple-battery";
                brand = "atl-4V45-5000mAh";
                charge-full-design-microamp-hours = <4872000>;
                charge-term-current-microamp = <256000>;
                constant_charge_voltage_max_microvolt = <4432000>;
                factory-internal-resistance-micro-ohms = <139000>;
                voltage-min-design-microvolt = <3455000>;
                ocv-capacity-celsius = <20>;
                ocv-capacity-table-0 = <4374000 100>, <4325000 95>, <4270000 90>,
                            <4214000 85>, <4159000 80>, <4106000 75>,
                            <4056000 70>, <4010000 65>, <3957000 60>,
                            <3903000 55>, <3871000 50>, <3845000 45>,
                            <3823000 40>, <3805000 35>, <3788000 30>,
                            <3764000 25>, <3743000 20>, <3718000 15>,
                            <3691000 10>, <3677000 5>, <3400000 0>;
                voltage-temp-table = <1404000 650>, <1307000 700>, <1203000 750>,
                            <1095000 800>, <986000 850>, <878000 900>,
                            <775000 950>, <678000 1000>, <590000 1050>,
                            <510000 1100>, <440000 1150>, <378000 1200>,
                            <324000 1250>, <278000 1300>, <238000 1350>,
                            <204000 1400>, <175000 1450>, <150000 1500>,
                            <129000 1550>, <111000 1600>, <96000 1650>,
                            <83000 1700>, <73000 1750>, <63000 1800>,
                            <55000 1850>, <48000 1900>, <42000 1950>;
                capacity-temp-table = <45 100>, <25 100>, <10 98>, <0 92>, <(-10) 86>, <(-20) 65>;
                resistance-temp-table = <45 100>, <25 100>, <10 324>, <0 854>, <(-10) 901>, <(-20) 1022>;
                charge-sdp-current-microamp = <480000 500000>;
                charge-dcp-current-microamp = <1980000 2000000>;
                charge-cdp-current-microamp = <1500000 1500000>;
                charge-unknown-current-microamp = <1200000 1200000>;
                cm-dcp-jeita-temp-table = <980 981 0 3980000 0 3980000>,
					<1000 1030 480000 3980000 480000 3980000>,
					<1050 1080 480000 4435000 480000 4435000>,
					<1120 1150 1000000 4435000 1000000 4435000>,
					<1160 1190 1500000 4435000 1500000 4435000>,
					<1450 1420 1980000 4435000 1980000 4435000>,
					<1530 1500 1500000 4130000 1500000 4130000>;
				cm-sdp-jeita-temp-table = <980 981 0 3980000 0 3980000>,
					<1000 1030 480000 3980000 480000 3980000>,
					<1050 1080 480000 4435000 480000 4435000>,
					<1120 1150 480000 4435000 480000 4435000>,
					<1160 1190 480000 4435000 480000 4435000>,
					<1450 1420 480000 4435000 480000 4435000>,
					<1530 1500 480000 4130000 480000 4130000>;
				cm-cdp-jeita-temp-table = <980 981 0 3980000 0 3980000>,
					<1000 1030 480000 3980000 480000 3980000>,
					<1050 1080 480000 4435000 480000 4435000>,
					<1120 1150 1000000 4435000 1000000 4435000>,
					<1160 1190 1500000 4435000 1500000 4435000>,
					<1450 1420 1500000 4435000 1500000 4435000>,
					<1530 1500 1000000 4130000 1000000 4130000>;
				cm-unknown-jeita-temp-table = <980 981 0 3980000 0 3980000>,
					<1000 1030 480000 3980000 480000 3980000>,
					<1050 1080 480000 4435000 480000 4435000>,
					<1120 1150 1000000 4435000 1000000 4435000>,
					<1160 1190 1200000 4435000 1200000 4435000>,
					<1450 1420 1200000 4435000 1200000 4435000>,
					<1530 1500 1000000 4130000 1000000 4130000>;
            };
        };
    };
};
