## drivers/input/fingerprint/Kconfig
```kconfig
if INPUT_FINGERPRINT

config EGIS_FINGERPRINT
	tristate "config egis fingerprint"
	default n
	---help---
	  Say Y here if you want to take action when some keys are pressed;
	  
config ICNT_FINGERPRINT
	tristate "config chipone fingerprint"
	default n
	---help---
	  Say Y here if you want to take action when some keys are pressed;

config SILEAD_FINGERPRINT
	tristate "config silead fingerprint"
	default n
	---help---
	  Say Y here if you want to take action when some keys are pressed;

config FOCAL_FINGERPRINT
	tristate "config focaltech fingerprint"
	default n
	---help---
	  Say Y here if you want to take action when some keys are pressed;

endif
```

## drivers/input/touchscreen/ili9882n/Kconfig
```kconfig
#
# ili9881 driver
#
config TOUCHSCREEN_ILI9882N
	bool "ili9882n Touchscreen Driver"
	help
	  Say Y here if you have a ili9882n Touchscreen.

	  If unsure, say N.
```

## drivers/soc/oplus/Kconfig
```kconfig
config OPLUS_DEVICE_IFNO
        bool "config oplus devinfo"
        select OPLUS_ARCH_FILE
        help
        define this config to compile devinfo.c for device register.

source "drivers/soc/oplus/oplus_devinfo/Kconfig"
```
